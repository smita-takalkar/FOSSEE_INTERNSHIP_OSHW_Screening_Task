// ===================================================
// Arduino to ESP-IDF Conversion
// Generated by converter_ino_cpp.sh
// ===================================================

// ESP-IDF Headers
#include <stdio.h>
#include <string.h>
#include "freertos/FreeRTOS.h"
#include "freertos/task.h"
#include "driver/gpio.h"
#include "driver/uart.h"
#include "esp_log.h"


// Arduino to ESP32 GPIO mapping
int arduino_to_esp32(int pin) {
    // Common pin mapping for ESP32 dev boards
    const int mapping[] = {3,1,2,4,5,6,7,8,9,10,11,12,13,14};
    if (pin >= 0 && pin < 14) {
        return mapping[pin];
    }
    return pin;  // Use as-is for other pins
}

// Arduino pinMode()
void pinMode(int pin, int mode) {
    int gpio = arduino_to_esp32(pin);
    gpio_reset_pin(gpio);
    
    if (mode == 1) {  // OUTPUT
        gpio_set_direction(gpio, GPIO_MODE_OUTPUT);
    } else if (mode == 2) {  // INPUT_PULLUP
        gpio_set_direction(gpio, GPIO_MODE_INPUT);
        gpio_pullup_en(gpio);
    } else {  // INPUT (0)
        gpio_set_direction(gpio, GPIO_MODE_INPUT);
    }
    
}

// Arduino digitalWrite()
void digitalWrite(int pin, int value) {
    int gpio = arduino_to_esp32(pin);
    gpio_set_level(gpio, value);
}

// Arduino delay()
void delay(unsigned long ms) {
    vTaskDelay(ms / portTICK_PERIOD_MS);
}

// Serial implementation
void Serial_begin(unsigned long baud) {
    uart_config_t config = {
        .baud_rate = (int)baud,
        .data_bits = UART_DATA_8_BITS,
        .parity = UART_PARITY_DISABLE,
        .stop_bits = UART_STOP_BITS_1,
        .flow_ctrl = UART_HW_FLOWCTRL_DISABLE
    };
    
    uart_param_config(UART_NUM_0, &config);
    uart_driver_install(UART_NUM_0, 256, 0, 0, NULL, 0);
}

void Serial_print(const char* text) {
    printf("%s", text);
    uart_write_bytes(UART_NUM_0, text, strlen(text));
}

void Serial_println(const char* text) {
    printf("%s\n", text);
    uart_write_bytes(UART_NUM_0, text, strlen(text));
    uart_write_bytes(UART_NUM_0, "\n", 1);
}

// Arduino constants
#define INPUT 0
#define OUTPUT 1
#define INPUT_PULLUP 2
#define HIGH 1
#define LOW 0

// ===================================================
// USER'S ARDUINO CODE (Converted)
// ===================================================
// LED Blink
void setup() {
    pinMode(2, OUTPUT);
}

void loop() {
    digitalWrite(2, HIGH);
    delay(1000);
    digitalWrite(2, LOW);
    delay(1000);
}

// ESP-IDF entry point
extern "C" void app_main(void) {
    setup();
    while (1) {
        loop();
        vTaskDelay(10 / portTICK_PERIOD_MS);
    }
}
